## firmware_esp32/components/network_bridge/Kconfig.projbuild
```kconfig
menu "Aether TCP receiver configuration"

    config AETHER_TCP_HOST
        string "Laptop IPv4 address"
        default "10.0.0.20"
        help
            LAN IPv4 address of the laptop running the TCP JSON server.

    config AETHER_TCP_PORT
        int "Laptop TCP server port"
        range 1 65535
        default 8765

    config AETHER_TCP_MAX_LINE_LENGTH
        int "Maximum JSON line length"
        range 128 16384
        default 2048
        help
            Maximum number of bytes accepted for one newline-delimited JSON
            message. Longer messages are discarded.

endmenu
```

## firmware_esp32/components/wifi_manager/Kconfig.projbuild
```kconfig
menu "Aether Wi-Fi configuration"

    config AETHER_WIFI_STA_SSID
        string "Wi-Fi SSID"
        default ""
        help
            Name of the 2.4 GHz Wi-Fi network the ESP32-S3 should join.

    config AETHER_WIFI_STA_PASSWORD
        string "Wi-Fi password"
        default ""
        help
            Password for the configured Wi-Fi network.

    config AETHER_WIFI_STA_MAX_RETRY
        int "Maximum connection retries"
        range 1 100
        default 10

endmenu
```
